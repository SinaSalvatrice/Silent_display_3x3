## zmk/config/boards/shields/silent_display_3x3/Kconfig.shield
```kconfig
config SHIELD_SILENT_DISPLAY_3X3
    def_bool $(shields_list_contains,silent_display_3x3)
```

## zmk/config/west.yml
```yaml
manifest:
  remotes:
    - name: zmkfirmware
      url_base: https://github.com/zmkfirmware
  projects:
    - name: zmk
      remote: zmkfirmware
      revision: main
      url: https://github.com/zmkfirmware/zmk.git
      path: zmk
  self:
    path: config
```
